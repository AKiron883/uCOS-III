
	IMPORT	OSTCBCurPtr
	IMPORT	OSTCBHighRdyPtr
	
	EXPORT	OSStartHighRdy
	EXPORT	PendSV_Handler
		
NVIC_INT_CTRL		EQU		0xE000ED04
NVIC_SYSPRI14		EQU		0xE000ED22
NVIC_PENDSV_PRI		EQU			  0xFF
NVIC_PENDSVSET		EQU		0x10000000
	
	PRESERVE8
	THUMB	
	AREA CODE, CODE, READONLY
	
OSStartHighRdy
	LDR		R0, = NVIC_SYSPRI14
	LDR		R1, = NVIC_PENDSV_PRI
	STRB	R1, [R0]
	
	MOV		R0, #0
	MSR		PSP, R0
	
	LDR		R0, = NVIC_INT_CTRL
	LDR		R1, = NVIC_PENDSVSET
	STR		R1, [R0]
	
	CPSIE	I
	
OSStartHang
	B		OSStartHang
	

PendSV_Handler
	CPSID	I
	MRS		R0,PSP
	CBZ		R0, OS_CPU_PendSVHandler_nosave
	
	STMDB	R0!, {R4-R11}
	LDR		R1, = OSTCBCurPtr
	LDR		R1, [R1]
	STR		R0, [R1]
	
OS_CPU_PendSVHandler_nosave
	LDR		R0, = OSTCBCurPtr
	LDR		R1, = OSTCBHighRdyPtr
	LDR		R2, [R1]
	STR		R2, [R0]
	LDR		R0, [R2]
	LDMIA	R0!, {R4-R11}
	MSR		PSP,R0
	
	ORR		LR,LR,#0x04
	
	CPSIE	I
	BX		LR
	
	END
	